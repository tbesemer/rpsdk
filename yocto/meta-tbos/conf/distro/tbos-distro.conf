## yocto/meta-tbos/conf/distro/tbos-distro.conf
```bitbake
require conf/distro/poky.conf

DISTRO = "tbos-distro"
DISTRO_NAME = "Besemer OS"
SDK_VENDOR = "-tbossdk"

MAINTAINER = "Tom Besemer"

TARGET_VENDOR = "-tbos"

DISTROOVERRIDES = "tbos"

# Log information on images and packages
INHERIT += "buildhistory"
BUILDHISTORY_COMMIT = "1"

# Remove conflicting backends.
#DISTRO_FEATURES_remove = "x11 wayland directfb "

SDK_NAME = "tbos-${TCLIBC}-${SDK_ARCH}-${TUNE_PKGARCH}"
SDKPATH = "/opt/tbos/${SDK_VERSION}"
```

## yocto/meta-tbos/conf/layer.conf
```bitbake
# We have a conf and classes directory, add to BBPATH
BBPATH .= ":${LAYERDIR}"

# We have recipes-* directories, add to BBFILES
BBFILES += "${LAYERDIR}/recipes-*/*/*.bb ${LAYERDIR}/recipes-*/*/*.bbappend"

BBFILE_COLLECTIONS += "saos"
BBFILE_PATTERN_saos = "^${LAYERDIR}/"
BBFILE_PRIORITY_saos = "1"

# This should only be incremented on significant changes that will
# cause compatibility issues with other layers
LAYERVERSION_saos = "1"

LAYERDEPENDS_saos = "core"
```
